#pragma once
#include <stdint.h>
#include <stddef.h>
#include <string.h>

// Generated from Windows ToUnicodeEx by firmware/scripts/windows-layouts.ps1.
// Each character needs one or two HID strokes; the second handles dead keys.
enum TextLayoutId : int { LAYOUT_US, LAYOUT_CZ, LAYOUT_CZ_QWERTY };
struct TextStroke { uint8_t modifier; uint8_t usage; };
struct TextMapping { uint32_t codepoint; TextStroke strokes[2]; };
const TextMapping TEXT_US[] = {
  {0x0009, {{0,43},{0,0}}},
  {0x000A, {{0,40},{0,0}}},
  {0x0020, {{0,44},{0,0}}},
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  {0x007E, {{2,53},{0,0}}},
};
const TextMapping TEXT_CZ[] = {
  {0x0009, {{0,43},{0,0}}},
  {0x000A, {{0,40},{0,0}}},
  {0x0020, {{0,44},{0,0}}},
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  {0x20AC, {{64,8},{0,0}}},
};
const TextMapping TEXT_CZ_QWERTY[] = {
  {0x0009, {{0,43},{0,0}}},
  {0x000A, {{0,40},{0,0}}},
  {0x0020, {{0,44},{0,0}}},
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  {0x20AC, {{64,8},{0,0}}},
};

inline TextLayoutId textLayoutId(const char* name) {
  return !strcmp(name,"CZ") ? LAYOUT_CZ : !strcmp(name,"CZ_QWERTY") ? LAYOUT_CZ_QWERTY : LAYOUT_US;
}
inline bool validTextLayout(const char* name) {
  return !strcmp(name,"US") || !strcmp(name,"CZ") || !strcmp(name,"CZ_QWERTY");
}
inline const TextMapping* textMapping(uint32_t codepoint, TextLayoutId layout) {
  const TextMapping* table = layout == LAYOUT_CZ ? TEXT_CZ : layout == LAYOUT_CZ_QWERTY ? TEXT_CZ_QWERTY : TEXT_US;
  size_t length = layout == LAYOUT_US ? sizeof(TEXT_US)/sizeof(TEXT_US[0]) : sizeof(TEXT_CZ)/sizeof(TEXT_CZ[0]);
  size_t lo=0, hi=length;
  while (lo<hi) { size_t mid=lo+(hi-lo)/2; if (table[mid].codepoint<codepoint) lo=mid+1; else hi=mid; }
  return lo<length && table[lo].codepoint==codepoint ? table+lo : nullptr;
}
inline uint32_t decodeCodepoint(const char* text, size_t& offset) {
  const unsigned char* p=(const unsigned char*)text+offset;
  if (*p<0x80) { offset++; return *p; }
  int length=*p>=0xC2 && *p<=0xDF ? 2 : *p>=0xE0 && *p<=0xEF ? 3 : *p>=0xF0 && *p<=0xF4 ? 4 : 0;
  if (!length) return UINT32_MAX;
  uint32_t codepoint=*p & ((1 << (7-length))-1);
  for (int i=1; i<length; i++) { if (!p[i] || (p[i]&0xC0)!=0x80) return UINT32_MAX; codepoint=(codepoint<<6)|(p[i]&0x3F); }
  if ((length==3 && codepoint<0x800) || (length==4 && codepoint<0x10000) || codepoint>0x10FFFF || (codepoint>=0xD800 && codepoint<=0xDFFF)) return UINT32_MAX;
  offset+=length; return codepoint;
}
inline bool textSupported(const char* text, TextLayoutId layout) {
  size_t offset=0, units=0;
  while (text[offset]) { uint32_t cp=decodeCodepoint(text,offset); if (cp==UINT32_MAX || !textMapping(cp,layout)) return false; units+=cp>0xFFFF ? 2 : 1; }
  return units<=240;
}
